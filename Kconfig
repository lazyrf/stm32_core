## Kconfig
```kconfig
mainmenu "STM32 Core Configuration"

    menu "MCU"
        # Core option
        choice MCU_CORE
            prompt "MCU Core"
            default MCU_CORE_CM4
            help
                Cortex-M3
                Cortex-M4

            config MCU_CORE_CM3
                bool "Cortex-M3"

            config MCU_CORE_CM4
                bool "Cortex-M4"
        endchoice

        config MCU_CORE
            string
            default "cortex-m3" if MCU_CORE_CM3
            default "cortex-m4" if MCU_CORE_CM4

        # MCU series
        choice MCU_SERIES
            prompt "MCU series"
            default MCU_SERIES_STM32F429xx

            config MCU_SERIES_STM32F405xx
                bool "STM32F405xx"
                depends on MCU_CORE_CM4

            config MCU_SERIES_STM32F407xx
                bool "STM32F407xx"
                depends on MCU_CORE_CM4

            config MCU_SERIES_STM32F429xx
                bool "STM32F429xx"
                depends on MCU_CORE_CM4

            config MCU_SERIES_STM32F103xB
                bool "STM32F103xB"
                depends on MCU_CORE_CM3
        endchoice

        config MCU_SERIES
            string
            default "STM32F405xx" if MCU_SERIES_STM32F405xx
            default "STM32F407xx" if MCU_SERIES_STM32F407xx
            default "STM32F429xx" if MCU_SERIES_STM32F429xx
            default "STM32F103xB" if MCU_SERIES_STM32F103xB

        config MCU_FAMILY_F1
            bool
            default y if MCU_SERIES_STM32F103xB

        config MCU_FAMILY_F4
            bool
            default y if MCU_SERIES_STM32F405xx
            default y if MCU_SERIES_STM32F407xx
            default y if MCU_SERIES_STM32F429xx

        source "Kconfig.periph"
    endmenu

    menu "Compiler"
        # Debug option
        choice GCC_DEBUG_LEVEL
            prompt "Debug Level"
            default GCC_DEBUG_LEVEL_0
            help
                -g Debug information depend on OS (stabs, COFF, XCOFF or DWARF)
                -g0 No debug information
                -g1 Minimal debug information
                -g3 Maximum debug information

            config GCC_DEBUG_LEVEL_DEPEND_ON_OS
                bool "-g"

            config GCC_DEBUG_LEVEL_0
                bool "-g0"

            config GCC_DEBUG_LEVEL_1
                bool "-g1"

            config GCC_DEBUG_LEVEL_3
                bool "-g3"
        endchoice

        config GCC_DEBUG_LEVEL
            string
            default "-g" if GCC_DEBUG_LEVEL_DEPEND_ON_OS
            default "-g0" if GCC_DEBUG_LEVEL_0
            default "-g1" if GCC_DEBUG_LEVEL_1
            default "-g3" if GCC_DEBUG_LEVEL_3

        # C standard
        choice GCC_C_STANDARD
            prompt "C Standard"
            default GCC_C_STD_GNU11

            config GCC_C_STD_C90
                bool "c90"

            config GCC_C_STD_GNU90
                bool "gnu90"

            config GCC_C_STD_C99
                bool "c99"

            config GCC_C_STD_GNU99
                bool "gnu99"

            config GCC_C_STD_C11
                bool "c11"

            config GCC_C_STD_GNU11
                bool "gnu11"
        endchoice

        config GCC_C_STANDARD
            string
            default "c90" if GCC_C_STD_C90
            default "c99" if GCC_C_STD_C99
            default "c11" if GCC_C_STD_C11
            default "gnu90" if GCC_C_STD_GNU90
            default "gnu99" if GCC_C_STD_GNU99
            default "gnu11" if GCC_C_STD_GNU11

        # Optimization Level
        choice GCC_OPTIMIZATION_LEVEL
            prompt "Optimization Level"
            default GCC_OPTIMIZATION_LEVEL_0
            help
                -Og Standard edit-compile-debug cycle
                -O0 Without optimization
                -O1 Compiler tries to reduce code size and execution time
                -O2 Compiler performs nearly all supported optimizations
                -O3 TUrn on all optimizations
                -Os Optimization for size

            config GCC_OPTIMIZATION_LEVEL_G
                bool "-Og"

            config GCC_OPTIMIZATION_LEVEL_0
                bool "-O0"

            config GCC_OPTIMIZATION_LEVEL_1
                bool "-O1"

            config GCC_OPTIMIZATION_LEVEL_2
                bool "-O2"

            config GCC_OPTIMIZATION_LEVEL_3
                bool "-O3"

            config GCC_OPTIMIZATION_LEVEL_S
                bool "-Os"
        endchoice

        config GCC_OPTIMIZATION_LEVEL
            string
            default "-Og" if GCC_OPTIMIZATION_LEVEL_G
            default "-O0" if GCC_OPTIMIZATION_LEVEL_0
            default "-O1" if GCC_OPTIMIZATION_LEVEL_1
            default "-O2" if GCC_OPTIMIZATION_LEVEL_2
            default "-O3" if GCC_OPTIMIZATION_LEVEL_3
            default "-Os" if GCC_OPTIMIZATION_LEVEL_S

        # Data Section
        config GCC_FLAG_DATA_SECTIONS
            bool "-fdata-sections"
            default y
            help
                Place data in their own sections

        config GCC_DATA_SECTIONS
            string
            default "-fdata-sections" if GCC_FLAG_DATA_SECTIONS && y

        # Function Section
        config GCC_FLAG_FUNCTION_SECTIONS
            bool "-ffunction-sections"
            default y
            help
                Place functions in their own sections

        config GCC_FUNCTION_SECTIONS
            string
            default "-ffunction-sections" if GCC_FLAG_FUNCTION_SECTIONS && y

        # Stack usage
        config GCC_FLAG_STACK_USAGE
            bool "-fstack-usage"
            default y
            help
                A unit compiled with -fstack-usage will generate an extra file that specifies the maximum of stack used, on a per-function basis

        config GCC_STACK_USAGE
            string
            default "-fstack-usage" if GCC_FLAG_STACK_USAGE && y

        # Warning all
        config GCC_FLAG_WARNING_ALL
            bool "-Wall"
            default y
            help
                This enables all the warnings about constructions that some users consider questionable, and that are easy to avoid (or modify to prevent the warning), even in conjuction with marcos

        config GCC_WARNING_ALL
            string
            default "-Wall" if GCC_FLAG_WARNING_ALL && y

        # Warning error
        config GCC_FLAG_WARNING_ERROR
            bool "-Werror"
            default n
            help
                Make all warnings into errors

        config GCC_WARNING_ERROR
            string
            default "-Werror" if GCC_FLAG_WARNING_ERROR && y

        # Warning extra
        config GCC_FLAG_WARNING_EXTRA
            bool "-Wextra"
            default y
            help
                This enables some extra warning flags that are not enabled by -Wall

        config GCC_WARNING_EXTRA
            string
            default "-Wextra" if GCC_FLAG_WARNING_EXTRA && y

        # Warning no used parameter
        config GCC_FLAG_WARNING_NO_UNUSED_PARAMETER
            bool "-Wno-unused-parameter"
            default y
            help
                Turn off warn whenever a function parameter is unused aside from its declaration

        config GCC_WARNING_NO_UNUSED_PARAMETER
            string
            default "-Wno-unused-parameter" if GCC_FLAG_WARNING_NO_UNUSED_PARAMETER && y

        # Warning switch default
        config GCC_FLAG_WARNING_SWITCH_DEFAULT
            bool "-Wswitch-default"
            default n
            help
                Warn whenever a switch statement does not have a default case

        config GCC_WARNING_SWITCH_DEFAULT
            string
            default "-Wswitch-default" if GCC_FLAG_WARNING_SWITCH_DEFAULT && y

        # Warning switch enum
        config GCC_FLAG_WARNING_SWITCH_ENUM
            bool "-Wswitch-enum"
            default n
            help
                Warn whenever a switch statement has an index of enumerated type and lacks a case for one or more of the named codes of that enumeration

        config GCC_WARNING_SWITCH_ENUM
            string
            default "-Wswitch-enum" if GCC_FLAG_WARNING_SWITCH_ENUM && y

        # Printf float
        config GCC_FLAG_USE_PRINTF_FLOAT
            bool "-u_printf_float"
            default y
            help
                Use float with printf from newlib-nano

        config GCC_USE_PRINTF_FLOAT
            string
            default "-u_printf_float" if GCC_FLAG_USE_PRINTF_FLOAT && y

        # Scanf float
        config GCC_FLAG_USE_SCANF_FLOAT
            bool "-u_scanf_float"
            default n
            help
                Use float with scanf from newlib-nano

        config GCC_USE_SCANF_FLOAT
            string
            default "-u_scanf_float" if GCC_FLAG_USE_SCANF_FLOAT && y
    endmenu
```

## Kconfig.periph
```kconfig
menu "Peripheral"
    config MCU_PERIPH_ADC
        bool "ADC"
        default n

    config MCU_PERIPH_CAN
        bool "CAN"
        default n

    config MCU_PERIPH_CEC
        bool "CEC"
        default n

    config MCU_PERIPH_CRC
        bool "CRC"
        default y

    config MCU_PERIPH_CRYP
        bool "CRPY"
        default n

    config MCU_PERIPH_DAC
        bool "DAC"
        default n

    config MCU_PERIPH_DBGMCU
        bool "DBGMCU"
        default n

    config MCU_PERIPH_DCMI
        bool "DCMI"
        default n

    config MCU_PERIPH_DFSDM
        bool "DFSDM"
        default n

    config MCU_PERIPH_DMA
        bool "DMA"
        default y

    config MCU_PERIPH_DMA2D
        bool "DMA2D"
        default n

    config MCU_PERIPH_DSI
        bool "DSI"
        default n

    config MCU_PERIPH_EXTI
        bool "EXTI"
        default y

    config MCU_PERIPH_FLASH
        bool "FLASH"
        default y

    config MCU_PERIPH_FMC
        bool "FMC"
        default n

    config MCU_PERIPH_FMPI2C
        bool "FMPI2C"
        default n

    config MCU_PERIPH_FSMC
        bool "FSMC"
        default n

    config MCU_PERIPH_GPIO
        bool "GPIO"
        default y

    config MCU_PERIPH_HASH
        bool "HASH"
        default n

    config MCU_PERIPH_I2C
        bool "I2C"
        default y

    config MCU_PERIPH_IWDG
        bool "IWDG"
        default y

    config MCU_PERIPH_LPTIME
        bool "LPTIME"
        default n

    config MCU_PERIPH_LTDC
        bool "LTDC"
        default n

    config MCU_PERIPH_PWR
        bool "PWR"
        default y

    config MCU_PERIPH_QSPI
        bool "QSPI"
        default n

    config MCU_PERIPH_RCC
        bool "RCC"
        default y

    config MCU_PERIPH_RNG
        bool "RNG"
        default n

    config MCU_PERIPH_RTC
        bool "RTC"
        default y

    config MCU_PERIPH_SAI
        bool "SAI"
        default n

    config MCU_PERIPH_SDIO
        bool "SDIO"
        default y

    config MCU_PERIPH_SPDIFRX
        bool "SPDIFRX"
        default n

    config MCU_PERIPH_SPI
        bool "SPI"
        default y

    config MCU_PERIPH_SYSCFG
        bool "SYSCFG"
        default y

    config MCU_PERIPH_TIM
        bool "TIM"
        default y

    config MCU_PERIPH_USART
        bool "USART"
        default y

    config MCU_PERIPH_UART
        bool "UART"
        default y

    config MCU_PERIPH_WWDG
        bool "WWDG"
        default n

    config MCU_PERIPH_ETH
        bool "Ethernet"
        default n

    config MCU_PERIPH_I2S
        bool "I2S"
        default n

    config MCU_PERIPH_IRDA
        bool "IRDA"
        default n

    config MCU_PERIPH_NOR
        bool "NOR"
        default n

    config MCU_PERIPH_NAND
        bool "NAND"
        default n

    config MCU_PERIPH_PCCARD
        bool "PCCARD"
        default n

    config MCU_PERIPH_PCD
        bool "PCD"
        default n

    config MCU_PERIPH_HCD
        bool "HCD"
        default n

    config MCU_PERIPH_SD
        bool "SD"
        default n

    config MCU_PERIPH_MMC
        bool "MMC"
        default n

    config MCU_PERIPH_SDRAM
        bool "SDRAM"
        default n

    config MCU_PERIPH_SMARTCARD
        bool "SMARTCARD"
        default n

    config MCU_PERIPH_SRAM
        bool "SRAM"
        default n

    config MCU_PERIPH_DCMI
        bool "DCMI"
        default n

    config MCU_PERIPH_DMA2D
        bool "DMA2D"
        default n

    config MCU_PERIPH_HASH
        bool "HAS"
        default n

    config MCU_PERIPH_LTDC
        bool "LTDC"
        default n

    config MCU_PERIPH_RNG
        bool "RNG"
        default n

    config MCU_PERIPH_SAI
        bool "SAI"
        default n

    config MCU_PERIPH_SMBUS
        bool "SMBUS"
        default n

    config MCU_PERIPH_DSI
        bool "DSI"
        default n

    config MCU_PERIPH_QSPI
        bool "QSPI"
        default n

    config MCU_PERIPH_CEC
        bool "CEC"
        default n

    config MCU_PERIPH_FMPI2C
        bool "FMPI2C"
        default n

    config MCU_PERIPH_SPDIFRX
        bool "SPDIFRX"
        default n

    config MCU_PERIPH_DFSDM
        bool "DFSDM"
        default n

    config MCU_PERIPH_LPTIM
        bool "LPTIM"
        default n
endmenu
```
