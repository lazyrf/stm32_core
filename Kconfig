## kconfig/Kconfig.periph.f4x
```kconfig
menu "Peripheral"
    source "kconfig/Kconfig.periph.f4x.gpio"

    config MCU_PERIPH_ADC
        bool "ADC"
        default n

    config MCU_PERIPH_CAN
        bool "CAN"
        default n

    config MCU_PERIPH_CEC
        bool "CEC"
        default n

    config MCU_PERIPH_CRC
        bool "CRC"
        default y

    config MCU_PERIPH_CRYP
        bool "CRPY"
        default n

    config MCU_PERIPH_DAC
        bool "DAC"
        default n

    config MCU_PERIPH_DBGMCU
        bool "DBGMCU"
        default n

    config MCU_PERIPH_DCMI
        bool "DCMI"
        default n

    config MCU_PERIPH_DFSDM
        bool "DFSDM"
        default n

    config MCU_PERIPH_DMA
        bool "DMA"
        default y

    config MCU_PERIPH_DMA2D
        bool "DMA2D"
        default n

    config MCU_PERIPH_DSI
        bool "DSI"
        default n

    config MCU_PERIPH_EXTI
        bool "EXTI"
        default y

    config MCU_PERIPH_FLASH
        bool "FLASH"
        default y

    config MCU_PERIPH_FMC
        bool "FMC"
        default n

    config MCU_PERIPH_FMPI2C
        bool "FMPI2C"
        default n

    config MCU_PERIPH_FSMC
        bool "FSMC"
        default n

    config MCU_PERIPH_GPIO
        bool "GPIO"
        default y

    config MCU_PERIPH_HASH
        bool "HASH"
        default n

    config MCU_PERIPH_I2C
        bool "I2C"
        default y

    config MCU_PERIPH_IWDG
        bool "IWDG"
        default y

    config MCU_PERIPH_LPTIME
        bool "LPTIME"
        default n

    config MCU_PERIPH_LTDC
        bool "LTDC"
        default n

    config MCU_PERIPH_PWR
        bool "PWR"
        default y

    config MCU_PERIPH_QSPI
        bool "QSPI"
        default n

    config MCU_PERIPH_RCC
        bool "RCC"
        default y

    config MCU_PERIPH_RNG
        bool "RNG"
        default n

    config MCU_PERIPH_RTC
        bool "RTC"
        default y

    config MCU_PERIPH_SAI
        bool "SAI"
        default n

    config MCU_PERIPH_SDIO
        bool "SDIO"
        default y

    config MCU_PERIPH_SPDIFRX
        bool "SPDIFRX"
        default n

    config MCU_PERIPH_SPI
        bool "SPI"
        default y

    config MCU_PERIPH_SYSCFG
        bool "SYSCFG"
        default y

    config MCU_PERIPH_TIM
        bool "TIM"
        default y

    menuconfig MCU_PERIPH_USART
        bool "USART"
        default y

    if MCU_PERIPH_USART
        choice MCU_PERIPH_USART1
            prompt "USART1"
            default MCU_PERIPH_USART1_DISABLE
            help
                PINMAP1 (TX: PA9, RX: PA10)
                PINMAP2 (TX: PB6, RX: PB7)
                DISABLE

            config MCU_PERIPH_USART1_PINMAP1
                bool "TX: PA9, RX: PA10"

            config MCU_PERIPH_USART1_PINMAP2
                bool "TX: PB6, RX: PB7"

            config MCU_PERIPH_USART1_DISABLE
                bool "Disable"
        endchoice

        choice MCU_PERIPH_USART2
            prompt "USART2"
            default MCU_PERIPH_USART2_DISABLE
            help
                PINMAP1 (TX: PA2, RX: PA3)
                PINMAP2 (TX: PD5, RX: PD6)
                DISABLE

            config MCU_PERIPH_USART2_PINMAP1
                bool "TX: PA9, RX: PA10"

            config MCU_PERIPH_USART2_PINMAP2
                bool "TX: PB6, RX: PB7"

            config MCU_PERIPH_USART2_DISABLE
                bool "Disable"
        endchoice

        config MCU_PERIPH_USART3
            bool "USART3"

        config MCU_PERIPH_USART6
            bool "USART6"
    endif

    config MCU_PERIPH_UART
        bool "UART"
        default y

    config MCU_PERIPH_WWDG
        bool "WWDG"
        default n

    config MCU_PERIPH_ETH
        bool "Ethernet"
        default n

    config MCU_PERIPH_I2S
        bool "I2S"
        default n

    config MCU_PERIPH_IRDA
        bool "IRDA"
        default n

    config MCU_PERIPH_NOR
        bool "NOR"
        default n

    config MCU_PERIPH_NAND
        bool "NAND"
        default n

    config MCU_PERIPH_PCCARD
        bool "PCCARD"
        default n

    config MCU_PERIPH_PCD
        bool "PCD"
        default n

    config MCU_PERIPH_HCD
        bool "HCD"
        default n

    config MCU_PERIPH_SD
        bool "SD"
        default n

    config MCU_PERIPH_MMC
        bool "MMC"
        default n

    config MCU_PERIPH_SDRAM
        bool "SDRAM"
        default n

    config MCU_PERIPH_SMARTCARD
        bool "SMARTCARD"
        default n

    config MCU_PERIPH_SRAM
        bool "SRAM"
        default n

    config MCU_PERIPH_DCMI
        bool "DCMI"
        default n

    config MCU_PERIPH_DMA2D
        bool "DMA2D"
        default n

    config MCU_PERIPH_HASH
        bool "HAS"
        default n

    config MCU_PERIPH_LTDC
        bool "LTDC"
        default n

    config MCU_PERIPH_RNG
        bool "RNG"
        default n

    config MCU_PERIPH_SAI
        bool "SAI"
        default n

    config MCU_PERIPH_SMBUS
        bool "SMBUS"
        default n

    config MCU_PERIPH_DSI
        bool "DSI"
        default n

    config MCU_PERIPH_QSPI
        bool "QSPI"
        default n

    config MCU_PERIPH_CEC
        bool "CEC"
        default n

    config MCU_PERIPH_FMPI2C
        bool "FMPI2C"
        default n

    config MCU_PERIPH_SPDIFRX
        bool "SPDIFRX"
        default n

    config MCU_PERIPH_DFSDM
        bool "DFSDM"
        default n

    config MCU_PERIPH_LPTIM
        bool "LPTIM"
        default n
endmenu
```

## kconfig/Kconfig.periph.f4x.gpio
```kconfig
menuconfig MCU_PERIPH_GPIO
    bool "GPIO"

if MCU_PERIPH_GPIO
    menu "Port A"
        source "kconfig/Kconfig.periph.f4x.gpioa"
    endmenu

    menu "Port B"
        source "kconfig/Kconfig.periph.f4x.gpiob"
    endmenu

    menu "Port C"
        source "kconfig/Kconfig.periph.f4x.gpioc"
    endmenu

    menu "Port D"
        source "kconfig/Kconfig.periph.f4x.gpiod"
    endmenu

    menu "Port E"
        source "kconfig/Kconfig.periph.f4x.gpioe"
    endmenu

    menu "Port F"
        source "kconfig/Kconfig.periph.f4x.gpiof"
    endmenu

    menu "Port G"
        source "kconfig/Kconfig.periph.f4x.gpiog"
    endmenu

    menu "Port H"
        source "kconfig/Kconfig.periph.f4x.gpioh"
    endmenu

    menu "Port I"
        source "kconfig/Kconfig.periph.f4x.gpioi"
    endmenu

    if MCU_SERIES_STM32F429xx
        menu "Port J"
            source "kconfig/Kconfig.periph.f4x.gpioj"
        endmenu

        menu "Port K"
            source "kconfig/Kconfig.periph.f4x.gpiok"
        endmenu
    endif
endif
```
